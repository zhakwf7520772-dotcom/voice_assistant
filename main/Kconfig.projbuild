## main/Kconfig.projbuild
```kconfig
menu "Voice assistant settings"
    config VOICE_WIFI_SSID
        string "Wi-Fi SSID"
        default ""

    config VOICE_WIFI_PASSWORD
        string "Wi-Fi password (stored in firmware; use test network)"
        default ""

    config VOICE_HTTP_TIMEOUT_MS
        int "Wi-Fi connect and HTTP timeout (ms)"
        range 3000 60000
        default 45000

    config VOICE_END_SILENCE_MS
        int "Silence to finish utterance (ms)"
        range 400 3000
        default 500

    config LLM_SERVER_URL
        string "LLM server base URL (empty disables requests)"
        default ""

    config LLM_REQUEST_TIMEOUT_MS
        int "LLM HTTP timeout (ms)"
        range 1000 60000
        default 15000

    config LLM_DEVICE_ID
        string "Device ID (empty derives esp32_<MAC>)"
        default ""

    config LLM_SESSION_ID
        string "Initial session ID (empty generates one per boot)"
        default ""

    config LLM_MAX_RESPONSE_BYTES
        int "Maximum LLM response body bytes"
        range 256 8192
        default 4096

    config TTS_SERVER_URL
        string "TTS server base URL (HTTPS; empty disables speech output)"
        default ""

    config TTS_BEARER_TOKEN
        string "TTS bearer token (stored in firmware; do not commit sdkconfig)"
        default ""

    config TTS_REQUEST_TIMEOUT_MS
        int "TTS HTTP timeout (ms)"
        range 5000 180000
        default 150000

    config TTS_PLAYBACK_BUFFER_MS
        int "Audio to buffer before streaming WAV playback (ms)"
        range 500 5000
        default 1500

    config SPEAKER_VOLUME_PERCENT
        int "Speaker PCM volume (percent; start low)"
        range 1 100
        default 15

    config SPEAKER_STARTUP_TEST
        bool "Play two local speaker test tones at startup"
        default n
        help
            Test the MAX98357 wiring before starting voice recognition.
            Uses the same I2S playback path and volume as TTS, without Wi-Fi.
endmenu

menu "Infrared receiver settings"
    config IR_RECEIVER_DIAGNOSTICS
        bool "Log GPIO7 edge counts and RMT receive status"
        default y
        help
            Count GPIO7 transitions independently of RMT and print diagnostic
            counters every five seconds. GPIO interrupts only count edges;
            all logging remains in the normal IR logging task. Disable after
            verifying the receiver wiring to remove the diagnostic interrupts.
endmenu
```

## sdkconfig.defaults
```kconfig
CONFIG_IDF_TARGET="esp32s3"
CONFIG_ESPTOOLPY_FLASHSIZE_16MB=y
CONFIG_PARTITION_TABLE_CUSTOM=y
CONFIG_PARTITION_TABLE_CUSTOM_FILENAME="partitions.csv"
CONFIG_SPIRAM=y
CONFIG_SPIRAM_MODE_OCT=y
CONFIG_SPIRAM_SPEED_80M=y
CONFIG_SPIRAM_USE_MALLOC=y
CONFIG_SPIRAM_TRY_ALLOCATE_WIFI_LWIP=y
CONFIG_ESP_WIFI_STATIC_TX_BUFFER=y
CONFIG_ESP_WIFI_STATIC_TX_BUFFER_NUM=8
CONFIG_SR_VADN_VADNET1_MEDIUM=y
CONFIG_SR_WN_WN9_HILEXIN=y
CONFIG_ESP_WIFI_STATIC_RX_BUFFER_NUM=16
CONFIG_ESP_WIFI_DYNAMIC_RX_BUFFER_NUM=64
CONFIG_ESP_WIFI_RX_BA_WIN=16
CONFIG_LWIP_TCP_WND_DEFAULT=65535
CONFIG_LWIP_TCP_RECVMBOX_SIZE=48
CONFIG_LWIP_STATS=y
CONFIG_LWIP_TCP_SACK_OUT=y
CONFIG_LWIP_TCP_OOSEQ_MAX_PBUFS=0
# CONFIG_ESP_TLS_CLIENT_SESSION_TICKETS is not set
CONFIG_VOICE_END_SILENCE_MS=500
CONFIG_ESP_DEFAULT_CPU_FREQ_MHZ_240=y
CONFIG_MBEDTLS_EXTERNAL_MEM_ALLOC=y
```
